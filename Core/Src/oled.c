
#include "oled.h"
#include "gpio.h"

/* 软件模拟 I2C 延时函数 */
static void OLED_I2C_Delay(void)
{
    uint8_t i = 10;
    while(i--);
}

/* 设置 SCL 引脚电平 */
static void OLED_SCL_Set(uint8_t level)
{
    HAL_GPIO_WritePin(OLED_SCL_PORT, OLED_SCL_PIN, level ? GPIO_PIN_SET : GPIO_PIN_RESET);
}

/* 设置 SDA 引脚电平 */
static void OLED_SDA_Set(uint8_t level)
{
    HAL_GPIO_WritePin(OLED_SDA_PORT, OLED_SDA_PIN, level ? GPIO_PIN_SET : GPIO_PIN_RESET);
}

/* I2C 起始信号 */
void OLED_I2C_Start(void)
{
    OLED_SDA_Set(1);
    OLED_SCL_Set(1);
    OLED_I2C_Delay();
    OLED_SDA_Set(0);
    OLED_I2C_Delay();
    OLED_SCL_Set(0);
}

/* I2C 停止信号 */
void OLED_I2C_Stop(void)
{
    OLED_SDA_Set(0);
    OLED_SCL_Set(1);
    OLED_I2C_Delay();
    OLED_SDA_Set(1);
    OLED_I2C_Delay();
}

/* I2C 写入字节 */
void OLED_I2C_WriteByte(uint8_t byte)
{
    uint8_t i;
    for(i = 0; i < 8; i++)
    {
        OLED_SDA_Set((byte & 0x80) >> 7);
        byte <<= 1;
        OLED_SCL_Set(1);
        OLED_I2C_Delay();
        OLED_SCL_Set(0);
        OLED_I2C_Delay();
    }
    /* 等待 ACK */
    OLED_SDA_Set(1);
    OLED_SCL_Set(1);
    OLED_I2C_Delay();
    OLED_SCL_Set(0);
    OLED_I2C_Delay();
}

/* 写入命令 */
void OLED_WriteCmd(uint8_t cmd)
{
    OLED_I2C_Start();
    OLED_I2C_WriteByte(0x78);  /* OLED 地址 */
    OLED_I2C_WriteByte(OLED_CMD);
    OLED_I2C_WriteByte(cmd);
    OLED_I2C_Stop();
}

/* 写入数据 */
void OLED_WriteData(uint8_t data)
{
    OLED_I2C_Start();
    OLED_I2C_WriteByte(0x78);  /* OLED 地址 */
    OLED_I2C_WriteByte(OLED_DATA);
    OLED_I2C_WriteByte(data);
    OLED_I2C_Stop();
}

/* 字符点阵数据 (8x16) */
const uint8_t OLED_F8x16[][16] = {
    {0x00,0x00,0x00,0x00,0x00,0x00,0x00,0x00,0x00,0x00,0x00,0x00,0x00,0x00,0x00,0x00}, /* ' ' */
    {0x00,0x00,0x00,0xF8,0x00,0x00,0x00,0x00,0x00,0x00,0x00,0x38,0x00,0x00,0x00,0x00}, /* '!' */
    {0x00,0x00,0x00,0x70,0x00,0x80,0x00,0x00,0x00,0x08,0x00,0x30,0x00,0x40,0x00,0x00}, /* '"' */
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    {0x00,0x00,0x70,0x88,0x88,0x88,0x00,0x00,0x00,0x00,0x00,0x41,0x41,0x41,0x00,0x00}, /* 'z' */
};

/* 设置显示位置 */
void OLED_SetPos(uint8_t x, uint8_t y)
{
    OLED_WriteCmd(0xB0 + y);
    OLED_WriteCmd(((x & 0xF0) >> 4) | 0x10);
    OLED_WriteCmd(x & 0x0F);
}

/* 清屏 */
void OLED_Clear(void)
{
    uint8_t i, j;
    for(i = 0; i < 8; i++)
    {
        OLED_WriteCmd(0xB0 + i);
        OLED_WriteCmd(0x00);
        OLED_WriteCmd(0x10);
        for(j = 0; j < 128; j++)
        {
            OLED_WriteData(0x00);
        }
    }
}

/* 显示单个字符 */
void OLED_ShowChar(uint8_t x, uint8_t y, uint8_t chr)
{
    uint8_t i;
    OLED_SetPos(x, y);
    for(i = 0; i < 8; i++)
    {
        OLED_WriteData(OLED_F8x16[chr - ' '][i]);
    }
    OLED_SetPos(x, y + 1);
    for(i = 8; i < 16; i++)
    {
        OLED_WriteData(OLED_F8x16[chr - ' '][i]);
    }
}

/* 显示字符串 */
void OLED_ShowString(uint8_t x, uint8_t y, uint8_t *str)
{
    while(*str != '\0')
    {
        OLED_ShowChar(x, y, *str);
        x += 8;
        if(x > 120)
        {
            x = 0;
            y += 2;
        }
        str++;
    }
}

/* OLED 初始化 */
void OLED_Init(void)
{
    /* 1. 强制开启 GPIOB 组的外设时钟 */
    __HAL_RCC_GPIOB_CLK_ENABLE();

    /* 2. 强行初始化 PB6(SCL) 和 PB7(SDA) 为推挽输出、内部上拉模式 */
    GPIO_InitTypeDef GPIO_InitStructForOLED = {0};
    GPIO_InitStructForOLED.Pin = OLED_SCL_PIN | OLED_SDA_PIN;
    GPIO_InitStructForOLED.Mode = GPIO_MODE_OUTPUT_PP;
    GPIO_InitStructForOLED.Pull = GPIO_PULLUP;
    GPIO_InitStructForOLED.Speed = GPIO_SPEED_FREQ_HIGH;
    HAL_GPIO_Init(GPIOB, &GPIO_InitStructForOLED);

    /* 3. 接下来承接原有的 OLED 硬件复位与初始化序列 */
    HAL_Delay(100);
    
    OLED_WriteCmd(0xAE);  /* 关闭显示 */
    OLED_WriteCmd(0xD5);  /* 设置时钟分频因子 */
    OLED_WriteCmd(0x80);
    OLED_WriteCmd(0xA8);  /* 设置驱动路数 */
    OLED_WriteCmd(0x3F);
    OLED_WriteCmd(0xD3);  /* 设置显示偏移 */
    OLED_WriteCmd(0x00);
    OLED_WriteCmd(0x40);  /* 设置显示开始行 */
    OLED_WriteCmd(0x8D);  /* 电荷泵设置 */
    OLED_WriteCmd(0x14);  /* 开启电荷泵升压点亮屏幕 */
    OLED_WriteCmd(0x20);  /* 设置内存地址模式 */
    OLED_WriteCmd(0x02);  /* 页寻址模式 */
    OLED_WriteCmd(0xA1);  /* 段重定义设置 */
    OLED_WriteCmd(0xC8);  /* COM扫描方向 */
    OLED_WriteCmd(0xDA);  /* COM硬件引脚配置 */
    OLED_WriteCmd(0x12);
    OLED_WriteCmd(0x81);  /* 对比度设置 */
    OLED_WriteCmd(0xCF);
    OLED_WriteCmd(0xD9);  /* 设置预充电周期 */
    OLED_WriteCmd(0xF1);
    OLED_WriteCmd(0xDB);  /* VCOMH取消选择级别 */
    OLED_WriteCmd(0x30);
    OLED_WriteCmd(0xA4);  /* 全局显示开启 */
    OLED_WriteCmd(0xA6);  /* 设置正常显示 */
    OLED_WriteCmd(0xAF);  /* 开启显示 */
    
    OLED_Clear();
}